## conf/layer.conf
```bitbake
# We have a conf and classes directory, add to BBPATH
BBPATH .= ":${LAYERDIR}"

# We have recipes-* directories, add to BBFILES
BBFILES += "${LAYERDIR}/recipes-*/*/*.bb \
            ${LAYERDIR}/recipes-*/*/*.bbappend"

BBFILE_COLLECTIONS += "meta-huricane"
BBFILE_PATTERN_meta-huricane = "^${LAYERDIR}/"
BBFILE_PRIORITY_meta-huricane = "6"

LAYERDEPENDS_meta-huricane = "core"
LAYERSERIES_COMPAT_meta-huricane = "scarthgap"
```

## wic/generic-bootdisk-AB-dm.wks
```
# based off of refkit's refkit-directdisk.wks.in kickstart template
# uses the image's boot directory to populate a vfat boot partition,
# which works with EFI.
bootloader --ptable gpt
part /boot --source rawcopy --label msdos --fstype=vfat --active --sourceparams="file=${DEPLOY_DIR_IMAGE}/boot.img"
part / --source rawcopy --sourceparams="file=${DEPLOY_DIR_IMAGE}/${DM_VERITY_IMAGE}-${MACHINE}.rootfs.${DM_VERITY_IMAGE_TYPE}.verity"
part / --source rawcopy --sourceparams="file=${DEPLOY_DIR_IMAGE}/${DM_VERITY_IMAGE}-${MACHINE}.rootfs.${DM_VERITY_IMAGE_TYPE}.verity"
```
